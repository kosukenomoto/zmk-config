## boards/shields/yuka_macropad/Kconfig.defconfig
```kconfig
if SHIELD_YUKA_MACROPAD

config ZMK_KEYBOARD_NAME
    default "yuka-macropad"

# 電池・省電力関連
config ZMK_BATTERY_REPORTING
    default y
config ZMK_SLEEP
    default y
config ZMK_PM_SOFT_OFF
    default y

# エンコーダーを使う場合
config EC11
    default y

# 設定の保存を安定させる（電池駆動時に推奨）
config ZMK_SETTINGS_SAVE_DEBOUNCE
    default 10000

endif # SHIELD_YUKA_MACROPAD
```

## config/west.yml
```yaml
manifest:
  version: 1.2
  defaults:
    revision: main
  remotes:
    - name: zmkfirmware
      url-base: https://github.com/zmkfirmware
  projects:
    - name: zmk
      remote: zmkfirmware
      revision: v0.3-branch
      import: app/west.yml
  self:
    path: config
```
