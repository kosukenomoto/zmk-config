## boards/shields/kosuke_macropad/Kconfig.defconfig
```kconfig
if SHIELD_KOSUKE_MACROPAD

config ZMK_KEYBOARD_NAME
    default "kosuke-macropad"

endif # SHIELD_YUKA_MACROPAD
```

## boards/shields/kosuke_macropad/Kconfig.shield
```kconfig
config SHIELD_KOSUKE_MACROPAD
    def_bool $(shields_list_contains,kosuke_macropad)
```
